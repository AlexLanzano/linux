## Documentation/devicetree/bindings/iio/imu/bosch,bmi270.yaml
```yaml
# SPDX-License-Identifier: (GPL-2.0 OR BSD-2-Clause)
%YAML 1.2
---
$id: http://devicetree.org/schemas/iio/imu/bosch,bmi270.yaml#
$schema: http://devicetree.org/meta-schemas/core.yaml#

title: Bosch BMI270 6-Axis IMU

maintainers:
  - Alex Lanzano <lanzano.alex@gmail.com>

description:
  BMI270 is a 6-axis inertial measurement unit that supports acceleration and
  gyroscopic measurements with hardware fifo buffering. Sensor also provides
  events information such as motion, steps, orientation, single and double
  tap detection.

properties:
  compatible:
    const: bosch,bmi270

  reg:
    maxItems: 1

required:
  - compatible
  - reg

allOf:
  - $ref: /schemas/spi/spi-peripheral-props.yaml#

unevaluatedProperties: false

examples:
  - |
    i2c {
        #address-cells = <1>;
        #size-cells = <0>;

        imu@68 {
            compatible = "bosch,bmi270";
            reg = <0x68>;
        };
    };
```
